## kernel/drivers/sstar/cpufreq/Kconfig
```kconfig
config SSTAR_CPU_FREQ
	tristate "Mstar CPU frequency scaling driver"
    select CPU_FREQ
    select CPU_FREQ_GOV_ONDEMAND
    select PM_OPP
```

## project/configs/Kconfigs/sdk/verify/Kconfig
```kconfig
menu "Verify Compile Config"
source configs/Kconfigs/sdk/verify/mi_demo/Kconfig
source configs/Kconfigs/sdk/verify/sample_code/Kconfig
source configs/Kconfigs/sdk/verify/bsp_demo/Kconfig
source configs/Kconfigs/sdk/verify/sstar_ota/Kconfig
source configs/Kconfigs/sdk/verify/system_app/Kconfig

endmenu
```

## project/configs/demo/defconfigs/ipc_iford.nor.uclibc-9.1.0-squashfs.ssz029c.128.qfn128_ddr3_demo_aov_fast_defconfig
```kconfig
CONFIG_iford=y
CONFIG_IPC=y
CONFIG_BOARD="029C"
CONFIG_BOARD_NAME="SSZ029C-S01B"
CONFIG_TOOLCHAIN_UCLIBC=y
CONFIG_TOOLCHAIN_REL_ARM-SIGMASTAR-LINUX-UCLIBCGNUEABIHF-9.1.0=y
CONFIG_BUSYBOX="busybox-1.20.2-arm-buildroot-linux-uclibcgnueabihf-uclibc-9.1.0-static"
CONFIG_UBOOT_CONFIG="iford_defconfig"
CONFIG_OPTEE_OS_MAKE_OPTION="PLATFORM=iford"
CONFIG_DRAM_SIZE="0x8000000"
CONFIG_LX_MEM_SIZE="0x8000000"
CONFIG_MMA_MEM_SIZE="0x4000000"
CONFIG_CMA_MEM_SIZE="0x200000"
CONFIG_KERNEL_VERSION_5.10=y
CONFIG_KERNEL_CONFIG="iford_ssz029c_s01b_nor_demo_fast_defconfig"
CONFIG_IMAGE_CONFIG="nor-ramdisk.partition.config"
CONFIG_IPL_CONFIG="IPL.iford_nor_fast.QFN128_1333=y.SIMPLE_AUTOK=y.bin"
CONFIG_IPL_CUST_CONFIG="IPL_CUST.iford_nor_fast.QFN128_1333=y.SIMPLE_AUTOK=y.bin"
CONFIG_USB_UPGRADE_IPL_CONFIG="IPL.iford_usb.QFN128_1333=y.SIMPLE_AUTOK=y.bin"
CONFIG_USB_UPGRADE_UBOOT_CONFIG="u-boot.xz.img.bin"
CONFIG_SD_UPGRADE_IPL_CONFIG="IPL.iford_sdmmc.QFN128=y.SIMPLE_AUTOK=y.bin"
CONFIG_SD_UPGRADE_IPL_CUST_CONFIG="IPL_CUST.iford_sdmmc.QFN128=y.SIMPLE_AUTOK=y.bin"
CONFIG_SD_UPGRADE_DEV=1
CONFIG_FLASH_SIZE_16M=y
CONFIG_REMOVE_LIBS_LIST="libBF_2MIC_LINUX.so libBF_4MIC_LINUX.so libMIX_LINUX.so libSED_LINUX.so libSRC_LINUX.so libSSL_2MIC_LINUX.so libSSL_4MIC_LINUX.so libVAD_LINUX.so libfbc_decode.so libAED_LINUX.so libSE_LINUX.so libAPC_LINUX.so libANR_LINUX.so libsstaralgo_fr.so libAED_LINUX.so libBF100_LINUX.so"
CONFIG_CONFIG_ENABLE_POWER_SAVE_AOV=y
CONFIG_DLA_FIRMWARE_LIST="ipu_net/det/spdy48.img"
CONFIG_IQ0="imx307/imx307_iqfile.bin"
CONFIG_IQ1="imx307/imx307_iqfile.bin"
CONFIG_IQ2="imx307/imx307_iqfile.bin"
CONFIG_IQ3="imx307/imx307_iqfile.bin"
CONFIG_IQ_API_LIST="os04d10/os04d10_api.bin"
CONFIG_SENSOR_LIST="os04d10_mipi.ko"
CONFIG_SENSOR0="os04d10_mipi.ko"
CONFIG_SENSOR0_OPT="chmap=1 mclk=27M sleep_mode=2"
CONFIG_CONFIG_ENABLE_MI_NORMAL_STR=y
CONFIG_DEBUG_SUPPORT=y
CONFIG_SD_UPGRADE_DEV=1
CONFIG_PACK_MOD_LIST="sstar_netphy.ko sstar_emac.ko"
CONFIG_CUST_MODPARAM="modparam_aov_purelinux.json"
# CONFIG_ENABLE_MI_KAPI is not set
# CONFIG_ENABLE_MI_LOG_FUNCTION is not set
# CONFIG_ENABLE_MI_LOG_FILE is not set
# CONFIG_MI_FB_NORMAL is not set
# CONFIG_INTERFACE_FB is not set
# CONFIG_MI_FB_VIDEO is not set
CONFIG_INTERFACE_IVE=y
# CONFIG_INTERFACE_LDC is not set
# CONFIG_MI_RGN_SUPPORT_COVER_MAP is not set
# CONFIG_MI_RGN_SUPPORT_COLOR_INVERT is not set
# CONFIG_MI_RGN_SUPPORT_IFCD is not set
# CONFIG_MI_RGN_SUPPORT_MOSAIC is not set
# CONFIG_INTERFACE_VDISP is not set
# CONFIG_INTERFACE_WLAN is not set
# CONFIG_INTERFACE_DUMMY is not set
# CONFIG_VERIFY_MI_DEMO is not set
CONFIG_COMBINE_MI_MODULE=y
CONFIG_MI_DBG_WRN=y
```
